## boards/shields/Kconfig.defconfig
```kconfig
if SHIELD_DCHOI_LEFT

config ZMK_KEYBOARD_NAME
    default "dchoi"

config ZMK_SPLIT_ROLE_CENTRAL
    default y

endif

if SHIELD_DCHOI_LEFT || SHIELD_DCHOI_RIGHT

config ZMK_SPLIT
    default y

endif
```

## config/boards/shields/Kconfig.shield
```kconfig
config SHIELD_DCHOI_LEFT
    def_bool $(shields_list_contains,dchoi_left)

config SHIELD_DCHOI_RIGHT
    def_bool $(shields_list_contains,dchoi_right)
```

## config/boards/shields/dchoi/Kconfig.defconfig
```kconfig
if SHIELD_DCHOI_LEFT

config BT_DEVICE_NAME
    string "Logitech G915"

config ZMK_KEYBOARD_NAME
    string "Logitech G915"

config ZMK_SPLIT_ROLE_CENTRAL
    default y

endif

if SHIELD_DCHOI_LEFT || SHIELD_DCHOI_RIGHT

config BT_DEVICE_NAME
    string "Logitech G915"

config ZMK_KEYBOARD_NAME
    string "Logitech G915"

config ZMK_SPLIT
    default y

endif
```
